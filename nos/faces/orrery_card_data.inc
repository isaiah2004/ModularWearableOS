/* Prototype profile samples and facts; units are kelvin, hours, km or bar. */
typedef struct { float v; const char *s; } axis_tick;
typedef struct { const char *title, *note; float x0,x1,y0,y1; int vertical,ylog,yinv,n; float pts[14][2]; int nx,ny; axis_tick xt[5],yt[4]; float mark; const char *mark_text; } heat_profile;
static const heat_profile profiles[OB_N] = {
{"INSIDE OUT / RADIUS","CORONA HEAT / UNSOLVED",0,1.3,3000,20000000,0,1,0,11,{{0,15700000},{0.25,7000000},{0.5,3500000},{0.7,2000000},{0.9,500000},{0.99,20000},{1,5772},{1.01,4400},{1.05,10000},{1.1,500000},{1.3,1500000}},4,3,{{0,"CORE"},{0.7,"0.7"},{1,"SURFACE"},{1.3,"CORONA"}},{{10000,"10K"},{1000000,"1M"},{15000000,"15M"}},0,0},
{"EQUATOR / ONE SOLAR DAY (176 D)","MODEL / AIRLESS",0,24,50,750,0,0,0,12,{{0,105},{5.9,100},{6,150},{7,450},{9,610},{12,700},{15,610},{17,450},{18,300},{19,180},{21,125},{24,105}},5,3,{{0,"0H"},{6,"6H"},{12,"NOON"},{18,"18H"},{24,"24H"}},{{100,"100K"},{400,"400K"},{700,"700K"}},12,"SUN OVERHEAD"},
{"ALTITUDE / DAY = NIGHT","VIRA / GROUND 92 BAR",150,760,0,100,1,0,0,12,{{0,737},{10,658},{20,577},{30,496},{40,417},{50,350},{55,302},{60,263},{70,230},{80,197},{90,170},{100,175}},3,3,{{200,"200K"},{450,"450K"},{700,"700K"}},{{0,"0KM"},{50,"50"},{100,"100"}},55,"30 C / 0.5 BAR"},
{"MEAN SURFACE / BY LATITUDE","CLIMATE MEAN / MODEL",-90,90,200,320,0,0,0,13,{{-90,224},{-75,240},{-60,268},{-45,281},{-30,290},{-15,297},{0,299},{15,299},{30,293},{45,281},{60,267},{75,255},{90,250}},3,3,{{-90,"S"},{0,"EQ"},{90,"N"}},{{220,"220K"},{270,"270K"},{310,"310K"}},0,0},
{"EQUATOR / ONE LUNAR DAY (29.5 D)","LRO DIVINER-LIKE MODEL",0,24,50,420,0,0,0,10,{{0,100},{5.9,95},{6,140},{8,330},{12,390},{16,330},{18,250},{19,160},{21,115},{24,100}},5,3,{{0,"0H"},{6,"6H"},{12,"NOON"},{18,"18H"},{24,"24H"}},{{100,"100K"},{250,"250K"},{400,"400K"}},12,"SUN OVERHEAD"},
{"EQUATOR / SOL 24H 40M","CURIOSITY REMS MODEL",0,24,160,310,0,0,0,11,{{0,195},{3,188},{6,184},{8,220},{10,262},{13,293},{15,285},{17,262},{19,225},{21,208},{24,195}},5,3,{{0,"0H"},{6,"6H"},{12,"NOON"},{18,"18H"},{24,"24H"}},{{180,"180K"},{240,"240K"},{300,"300K"}},13,"WARMEST"},
{"DEPTH / PRESSURE (BAR)","GALILEO PROBE MODEL",100,450,0.001,20,1,1,1,8,{{0.001,160},{0.01,150},{0.1,110},{0.3,120},{1,165},{3,230},{10,330},{20,410}},3,4,{{110,"110K"},{250,"250K"},{420,"420K"}},{{0.001,"1MB"},{0.1,"0.1"},{1,"1 BAR"},{20,"20"}},1,"1 BAR 165K"},
{"DEPTH / PRESSURE (BAR)","VOYAGER / CASSINI",70,300,0.001,10,1,1,1,7,{{0.001,140},{0.01,130},{0.1,84},{0.3,95},{1,134},{3,180},{10,265}},3,4,{{80,"80K"},{180,"180K"},{280,"280K"}},{{0.001,"1MB"},{0.1,"0.1"},{1,"1 BAR"},{10,"10"}},1,"1 BAR 134K"},
{"DEPTH / PRESSURE (BAR)","VOYAGER 2 / COLD AIR",40,160,0.001,10,1,1,1,7,{{0.001,110},{0.01,80},{0.1,53},{0.3,58},{1,76},{3,102},{10,150}},3,4,{{50,"50K"},{100,"100K"},{150,"150K"}},{{0.001,"1MB"},{0.1,"0.1"},{1,"1 BAR"},{10,"10"}},0.1,"53K"},
{"DEPTH / PRESSURE (BAR)","VOYAGER 2 / INNER HEAT",40,160,0.001,10,1,1,1,7,{{0.001,140},{0.01,100},{0.1,55},{0.3,60},{1,72},{3,97},{10,145}},3,4,{{50,"50K"},{100,"100K"},{150,"150K"}},{{0.001,"1MB"},{0.1,"0.1"},{1,"1 BAR"},{10,"10"}},1,"1 BAR 72K"},
{"SURFACE / ONE DAY (6.4 D)","NEW HORIZONS / N2 ICE",0,24,30,60,0,0,0,7,{{0,37},{6,36},{9,42},{12,48},{15,45},{18,40},{24,37}},5,3,{{0,"0H"},{6,"6H"},{12,"NOON"},{18,"18H"},{24,"24H"}},{{35,"35K"},{45,"45K"},{55,"55K"}},0,0},
};
static const char *const facts[OB_N][5][2] = {
{{"RADIUS","696,000 KM"},{"SURFACE","5,500 DEGC"},{"SPIN","25 D AT EQUATOR"},{"MASS","333,000 EARTHS"},{"AGE","4.6 BN YEARS"}},
{{"RADIUS","2,440 KM"},{"SOLAR DAY","176 D"},{"YEAR","88 D"},{"GRAVITY","0.38 G"},{"MOONS","NONE"}},
{{"RADIUS","6,052 KM"},{"SOLAR DAY","117 D, BACKWARDS"},{"YEAR","225 D"},{"GROUND","464 DEGC / 92 BAR"},{"GRAVITY","0.90 G"}},
{{"RADIUS","6,371 KM"},{"DAY","24 H"},{"YEAR","365.25 D"},{"TILT","23.4 DEG"},{"MOONS","1 + 12,000 SATELLITES"}},
{{"RADIUS","1,737 KM"},{"MONTH","29.5 D"},{"GRAVITY","0.17 G"},{"DRIFTING","3.8 CM / YEAR AWAY"}},
{{"RADIUS","3,390 KM"},{"SOL","24 H 40 M"},{"YEAR","687 D"},{"GRAVITY","0.38 G"},{"HIGHEST","OLYMPUS MONS 22 KM"}},
{{"RADIUS","69,911 KM"},{"DAY","9 H 56 M"},{"YEAR","11.9 Y"},{"GRAVITY","2.53 G"},{"RED SPOT","WIDER THAN EARTH"}},
{{"RADIUS","58,232 KM"},{"DAY","10 H 33 M"},{"YEAR","29.5 Y"},{"DENSITY","LESS THAN WATER"},{"RINGS","~10 M THICK"}},
{{"RADIUS","25,362 KM"},{"DAY","17 H 14 M"},{"YEAR","84 Y"},{"TILT","98 DEG / ROLLS ON ITS SIDE"},{"VISITED","VOYAGER 2, 1986"}},
{{"RADIUS","24,622 KM"},{"DAY","16 H 6 M"},{"YEAR","165 Y"},{"WINDS","2,100 KM/H"},{"VISITED","VOYAGER 2, 1989"}},
{{"RADIUS","1,188 KM"},{"DAY","6.4 D"},{"YEAR","248 Y"},{"MOONS","5 / CHARON HALF ITS SIZE"},{"VISITED","NEW HORIZONS, 2015"}},
};
